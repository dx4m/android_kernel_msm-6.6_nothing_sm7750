&mdss_mdp {
	dsi_rm69260_amoled_120hz_vid_boe: qcom,mdss_dsi_rm69260_120hz_fhd_plus_dsc_vid_boe {
		qcom,mdss-dsi-panel-name =
			"rm69260 amoled vid mode dsi boe panel with DSC";
		qcom,mdss-dsi-panel-type = "dsi_video_mode";
		qcom,mdss-dsi-panel-physical-type = "oled";
		qcom,mdss-dsi-virtual-channel-id = <0>;
		qcom,mdss-dsi-stream = <0>;
		qcom,mdss-dsi-bpp = <24>;
		qcom,mdss-dsi-color-order = "rgb_swap_rgb";
		qcom,mdss-dsi-underflow-color = <0xff>;
		qcom,mdss-dsi-border-color = <0>;
		qcom,dsi-ctrl-num = <0>;
		qcom,dsi-phy-num = <0>;
		qcom,mdss-dsi-panel-hdr-enabled;
		qcom,mdss-dsi-panel-hdr-color-primaries = <15635 16450 34000
						16000 13250 34500 7500 3000>;
		qcom,mdss-dsi-panel-peak-brightness = <16000000>;
		qcom,mdss-dsi-panel-blackness-level = <1>;
		qcom,mdss-dsi-traffic-mode = "non_burst_sync_event";
		qcom,mdss-dsi-bllp-power-mode;
		qcom,mdss-dsi-bllp-eof-power-mode;
		qcom,mdss-dsi-lane-map = "lane_map_0123";
		qcom,mdss-dsi-lane-0-state;
		qcom,mdss-dsi-lane-1-state;
		qcom,mdss-dsi-lane-2-state;
		qcom,mdss-dsi-lane-3-state;
		qcom,mdss-dsi-dma-trigger = "trigger_sw";
		qcom,mdss-dsi-mdp-trigger = "none";
		qcom,mdss-disable-cesta-hw-sleep;
		qcom,mdss-dsi-reset-sequence = <1 5>, <0 5>, <1 5>;
		qcom,mdss-pan-physical-width-dimension = <71>;
		qcom,mdss-pan-physical-height-dimension = <158>;
		qcom,mdss-dsi-display-timings {
			timing@0 {
				cell-index = <0>;
				qcom,mdss-dsi-panel-framerate = <120>;
				qcom,mdss-dsi-panel-width = <1260>;
				qcom,mdss-dsi-panel-height = <2800>;
				qcom,mdss-dsi-h-front-porch = <204>;
				qcom,mdss-dsi-h-back-porch = <12>;
				qcom,mdss-dsi-h-pulse-width = <4>;
				qcom,mdss-dsi-h-sync-skew = <0>;
				qcom,mdss-dsi-v-back-porch = <62>;
				qcom,mdss-dsi-v-front-porch = <88>;
				qcom,mdss-dsi-v-pulse-width = <2>;
				qcom,mdss-dsi-h-left-border = <0>;
				qcom,mdss-dsi-h-right-border = <0>;
				qcom,mdss-dsi-v-top-border = <0>;
				qcom,mdss-dsi-v-bottom-border = <0>;
				qcom,mdss-dsi-panel-jitter = <0x4 0x1>;
				qcom,vid-on-commands = [
					15 01 00 00 00 00 02 FE A0
					15 01 00 00 00 00 02 06 76
					15 01 00 00 00 00 02 7C 1F
					15 01 00 00 00 00 02 FE 42
					15 01 00 00 00 00 02 78 15
					15 01 00 00 00 00 02 FE D4
					15 01 00 00 00 00 02 40 03
					15 01 00 00 00 00 02 42 00
					15 01 00 00 00 00 02 FE F7
					15 01 00 00 00 00 02 80 06
					15 01 00 00 00 00 02 83 00
					15 01 00 00 00 00 02 FE A1
					15 01 00 00 00 00 02 74 72
					15 01 00 00 00 00 02 C3 83
					15 01 00 00 00 00 02 C4 FF
					15 01 00 00 00 00 02 C5 3F
					15 01 00 00 00 00 02 FE 67
					15 01 00 00 00 00 02 D0 00
					15 01 00 00 00 00 02 FE A4
					15 01 00 00 00 00 02 01 00
					15 01 00 00 00 00 02 FE 9C
					15 01 00 00 00 00 02 12 55
					15 01 00 00 00 00 02 BD BB
					15 01 00 00 00 00 02 BB BB
					15 01 00 00 00 00 02 BC BB
					15 01 00 00 00 00 02 23 00
					15 01 00 00 00 00 02 FE 9A
					15 01 00 00 00 00 02 64 E0
					15 01 00 00 00 00 02 BF 0E
					15 01 00 00 00 00 02 C0 01
					15 01 00 00 00 00 02 C2 00
					15 01 00 00 00 00 02 C3 03
					15 01 00 00 00 00 02 FE 9B
					15 01 00 00 00 00 02 52 27
					15 01 00 00 00 00 02 14 32
					15 01 00 00 00 00 02 FE 46
					15 01 00 00 00 00 02 60 06
					15 01 00 00 00 00 02 FE 40
					15 01 00 00 00 00 02 3A 0C
					15 01 00 00 00 00 02 3B 30
					15 01 00 00 00 00 02 FE 00
					15 01 00 00 00 00 02 37 01
					15 01 00 00 00 00 02 FA 01
					15 01 00 00 00 00 02 C1 03
					15 01 00 00 00 00 02 C2 03
					15 01 00 00 00 00 02 35 00
					05 01 00 00 69 00 01 11
					05 01 00 00 0a 00 01 29
				];
				qcom,mdss-dsi-on-command-state = "dsi_lp_mode";
				qcom,mdss-dsi-off-command = [
					15 01 00 00 23 00 02 FE 00
					05 01 00 00 50 00 01 28
					05 01 00 00 20 00 01 10
				];
				qcom,mdss-dsi-off-command-state = "dsi_lp_mode";
				qcom,mdss-dsi-switch-144hz-command = [
					15 01 00 40 00 00 02 FE 00
					15 01 00 00 00 00 02 37 00
				];
				qcom,mdss-dsi-switch-144hz-command-state = "dsi_lp_mode";
				qcom,mdss-dsi-switch-120hz-command = [
					15 01 00 40 00 00 02 FE 00
					15 01 00 00 00 00 02 37 01
				];
				qcom,mdss-dsi-switch-120hz-command-state = "dsi_lp_mode";
				qcom,mdss-dsi-switch-90hz-command = [
					15 01 00 40 00 00 02 FE 00
					15 01 00 00 00 00 02 37 03
				];
				qcom,mdss-dsi-switch-90hz-command-state = "dsi_lp_mode";
				qcom,mdss-dsi-switch-60hz-command = [
					15 01 00 40 00 00 02 FE 00
					15 01 00 00 00 00 02 37 04
				];
				qcom,mdss-dsi-switch-60hz-command-state = "dsi_lp_mode";
				qcom,mdss-dsi-switch-30hz-command = [
					15 01 00 40 00 00 02 FE 00
					05 01 00 00 00 00 01 39
				];
				qcom,mdss-dsi-switch-30hz-command-state = "dsi_lp_mode";
				qcom,mdss-dsi-exit-30hz-command = [
					15 01 00 40 00 00 02 FE 00
					05 01 00 00 00 00 01 38
				];
				qcom,mdss-dsi-exit-30hz-command-state = "dsi_lp_mode";
				qcom,mdss-dsi-lhbm-on-command = [
					15 01 00 40 00 00 02 FE 00
					15 01 00 40 00 00 02 37 02
					15 01 00 40 00 00 02 83 01
					15 01 00 40 00 00 02 FE 22
					15 01 00 40 00 00 02 C8 0C
					15 01 00 00 00 00 02 FE 00];
				qcom,mdss-dsi-lhbm-on-command-state = "dsi_lp_mode";
				qcom,mdss-dsi-lhbm-off-command = [
					15 01 00 40 00 00 02 FE 00
					15 01 00 40 00 00 02 37 01
					15 01 00 40 00 00 02 83 00
					15 01 00 40 00 00 02 FE 22
					15 01 00 40 00 00 02 C8 00
					15 01 00 00 00 00 02 FE 00];
				qcom,mdss-dsi-lhbm-off-command-state = "dsi_lp_mode";
				qcom,mdss-dsi-switch-aod1-command = [
					15 01 00 40 00 00 02 FE 00
					05 01 00 40 00 00 01 39
					39 01 00 00 00 00 03 51 3F FC];
				qcom,mdss-dsi-switch-aod1-command-state = "dsi_hs_mode";
				qcom,mdss-dsi-switch-aod2-command = [
					15 01 00 40 00 00 02 FE 00
					05 01 00 40 00 00 01 39
					39 01 00 00 00 00 03 51 1D 19];
				qcom,mdss-dsi-switch-aod2-command-state = "dsi_hs_mode";
				qcom,mdss-dsi-switch-aod3-command = [
					15 01 00 40 00 00 02 FE 00
					05 01 00 40 00 00 01 39
					39 01 00 00 00 00 03 51 00 04];
				qcom,mdss-dsi-switch-aod3-command-state = "dsi_hs_mode";
				qcom,mdss-dsc-version = <0x11>;
				qcom,compression-mode = "dsc";
				qcom,mdss-dsc-slice-height = <8>;
				qcom,mdss-dsc-slice-width = <630>;
				qcom,mdss-dsc-slice-per-pkt = <2>;
				qcom,mdss-dsc-bit-per-component = <8>;
				qcom,mdss-dsc-bit-per-pixel = <8>;
				qcom,mdss-dsc-block-prediction-enable;
			};
		};
	};
};
