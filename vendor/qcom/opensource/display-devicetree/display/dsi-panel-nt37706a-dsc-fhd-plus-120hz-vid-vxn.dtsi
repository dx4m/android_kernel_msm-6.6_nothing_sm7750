&mdss_mdp {
	dsi_nt37706a_amoled_120hz_vid_vxn: qcom,mdss_dsi_nt37706a_120hz_fhd_plus_dsc_vid_vxn {
		qcom,mdss-dsi-panel-name =
			"nt37706a amoled vid mode dsi VXN panel with DSC";
		qcom,mdss-dsi-panel-type = "dsi_video_mode";
		qcom,mdss-dsi-panel-physical-type = "oled";
		qcom,mdss-dsi-virtual-channel-id = <0>;
		qcom,mdss-dsi-stream = <0>;
		qcom,mdss-dsi-bpp = <30>;
		qcom,mdss-dsi-color-order = "rgb_swap_rgb";
		qcom,mdss-dsi-underflow-color = <0xff>;
		qcom,mdss-dsi-border-color = <0>;

		qcom,dsi-ctrl-num = <0>;
		qcom,dsi-phy-num = <0>;

		qcom,mdss-dsi-traffic-mode = "non_burst_sync_event";
		qcom,mdss-dsi-bllp-power-mode;
		qcom,mdss-dsi-bllp-eof-power-mode;
		qcom,mdss-dsi-lane-map = "lane_map_0123";
		qcom,mdss-dsi-lane-0-state;
		qcom,mdss-dsi-lane-1-state;
		qcom,mdss-dsi-lane-2-state;
		qcom,mdss-dsi-lane-3-state;
		qcom,mdss-dsi-lp11-init;
		qcom,mdss-dsi-dma-trigger = "trigger_sw";
		qcom,mdss-dsi-mdp-trigger = "none";
		qcom,mdss-dsi-reset-sequence = <1 1>, <0 1>, <1 20>;
		qcom,mdss-pan-physical-width-dimension = <71>;
		qcom,mdss-pan-physical-height-dimension = <157>;

		qcom,mdss-dsi-display-timings {
			timing@0 {
				cell-index = <0>;
				qcom,mdss-dsi-panel-framerate = <120>;
				qcom,mdss-dsi-panel-width = <1224>;
				qcom,mdss-dsi-panel-height = <2720>;
				qcom,mdss-dsi-h-front-porch = <200>;
				qcom,mdss-dsi-h-back-porch = <180>;
				qcom,mdss-dsi-h-pulse-width = <8>;
				qcom,mdss-dsi-h-sync-skew = <0>;
				qcom,mdss-dsi-v-back-porch = <46>;
				qcom,mdss-dsi-v-front-porch = <76>;
				qcom,mdss-dsi-v-pulse-width = <2>;
				qcom,mdss-dsi-h-left-border = <0>;
				qcom,mdss-dsi-h-right-border = <0>;
				qcom,mdss-dsi-v-top-border = <0>;
				qcom,mdss-dsi-v-bottom-border = <0>;
				qcom,mdss-dsi-panel-jitter = <0x4 0x1>;

				qcom,vid-on-commands = [
					39 01 00 00 00 00 05 FF AA 55 A5 80
					15 01 00 00 00 00 02 6F 1F
					15 01 00 00 00 00 02 F4 0B
					15 01 00 00 00 00 02 6F 20
					15 01 00 00 00 00 02 F4 3F
					15 01 00 00 00 00 02 6F 08
					15 01 00 00 00 00 02 FC 03
					39 01 00 00 00 00 05 FF AA 55 A5 80
					15 01 00 00 00 00 02 6F 24
					15 01 00 00 00 00 02 F8 FF
					39 01 00 00 00 00 05 FF AA 55 A5 84
					15 01 00 00 00 00 02 6F 10
					15 01 00 00 00 00 02 F8 02
					39 01 00 00 00 00 05 FF AA 55 A5 84
					15 01 00 00 00 00 02 F2 15
					39 01 00 00 00 00 05 FF AA 55 A5 84
					15 01 00 00 00 00 02 6F 27
					15 01 00 00 00 00 02 F7 00
					39 01 00 00 00 00 05 FF AA 55 A5 84
					15 01 00 00 00 00 02 6F A9
					15 01 00 00 00 00 02 F4 F3
					15 01 00 00 00 00 02 87 00
					15 01 00 00 00 00 02 17 03
					39 01 00 00 00 00 05 2A 00 00 04 C7
					39 01 00 00 00 00 05 2B 00 00 0A 9F
					15 01 00 00 00 00 02 90 03
					15 01 00 00 00 00 02 6F 01
					15 01 00 00 00 00 02 90 43
					39 01 00 00 00 00 13 91 89 28 00 14 C2 00 02 32 02 07 00 08 05 0E 04 7D 10 F0
					15 01 00 00 00 00 02 53 20
					39 01 00 00 00 00 11 3B 00 30 00 50 00 30 00 4C 00 30 04 00 00 30 0B 68
					15 01 00 00 00 00 02 6F 10
					39 01 00 00 00 00 05 3B 00 30 00 4C
					15 01 00 00 00 00 02 88 01
					39 01 00 00 00 00 03 81 01 19
					15 01 00 00 00 00 02 35 00
					15 01 00 00 00 00 02 2F 00
					39 01 00 00 00 00 06 F0 55 AA 52 08 00
					15 01 00 00 00 00 02 BE 47
					05 01 00 00 78 00 01 11
					05 01 00 00 00 00 01 29

				];
				qcom,mdss-dsi-on-command-state = "dsi_lp_mode";
				qcom,mdss-dsi-off-command = [
					05 01 00 00 14 00 02 28 00
					05 01 00 00 50 00 02 10 00];
				qcom,mdss-dsi-off-command-state = "dsi_lp_mode";

				qcom,mdss-dsi-switch-120hz-command = [
					15 01 00 00 00 00 02 2F 00
				];
				qcom,mdss-dsi-switch-120hz-command-state = "dsi_hs_mode";
				qcom,mdss-dsi-switch-90hz-command = [
					15 01 00 00 00 00 02 2F 01
				];
				qcom,mdss-dsi-switch-90hz-command-state = "dsi_hs_mode";
				qcom,mdss-dsi-switch-60hz-command = [
					15 01 00 00 00 00 02 2F 02
				];
				qcom,mdss-dsi-switch-60hz-command-state = "dsi_hs_mode";

				qcom,compression-mode = "dsc";
				qcom,mdss-dsc-slice-height = <40>;
				qcom,mdss-dsc-slice-width = <612>;
				qcom,mdss-dsc-slice-per-pkt = <2>;
				qcom,mdss-dsc-bit-per-component = <10>;
				qcom,mdss-dsc-bit-per-pixel = <10>;
				qcom,mdss-dsc-block-prediction-enable;
			};
		};
	};
};
