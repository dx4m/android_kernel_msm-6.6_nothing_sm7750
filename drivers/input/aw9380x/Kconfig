## drivers/input/aw9380x/Kconfig
```kconfig
#
# cs press driver configuration
#

config AW9380X
	tristate "aw press"
	help
	  Say Y here if you have a press

	  If build module, say M.
	  If unsure, say N.
```

## drivers/leds/matrix-leds/Kconfig
```kconfig
config LEDS_MATRIX_LEDS
	tristate "LED Support for Nothing matrix led"
	help
	  this option enables support for the matrix LEDs connected
	  through SPI. Say Y to enable support for matrix LEDs automatically.
```
