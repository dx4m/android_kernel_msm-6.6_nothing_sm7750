// SPDX-License-Identifier: BSD-3-Clause
/*
 * Copyright (c) 2024 Qualcomm Innovation Center, Inc. All rights reserved.
 */

#include "tuna-pmiv0108.dtsi"

&pmiv010x_amoled {
	status= "ok";
};

&pmiv010x_eusb2_repeater {
	vdd18-supply = <&L7B>;
	vdd3-supply = <&L17B>;
	status = "ok";
	//Update USB eye parameter
	qcom,param-override-seq =
			<0xd 0x51
			0x4 0x54
			0x3 0x55
			0x7 0x57
			0x3 0x59>;
	qcom,host-param-override-seq =
			<0x6 0x51
			0x4 0x54
			0x0 0x55
			0x1 0x57
			0x0 0x59>;
};

&eusb2_phy0 {
	dummy-supply = <&pmiv010x_eusb2_repeater>;
	usb-repeater = <&pmiv010x_eusb2_repeater>;
};
